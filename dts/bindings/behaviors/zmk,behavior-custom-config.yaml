## dts/bindings/behaviors/zmk,behavior-custom-config.yaml
```yaml
# Copyright (c) 2025 The ZMK Contributors
# SPDX-License-Identifier: MIT

description: Custom Config Behavior

compatible: "zmk,behavior-custom-config"

include: one_param.yaml
```

## dts/bindings/zmk,custom-scroll-layers.yaml
```yaml
description: Custom config scroll layer defaults

compatible: "zmk,custom-scroll-layers"

properties:
  layers:
    type: array
    required: true
```
