/*
 * Copyright (c) 2026 The ZMK Contributors
 *
 * SPDX-License-Identifier: MIT
 */

/ {
    behaviors {
        mbt: mbt {
            compatible = "zmk,behavior-meteorite-bt-os";
            #binding-cells = <1>;
            display-name = "meteorite bt/os";
        };
    };
};
