/*
 * Copyright (c) 2025 The ZMK Contributors
 *
 * SPDX-License-Identifier: MIT
 */

/ {
    behaviors {
        // Behavior can be invoked on peripherals, so name must be <= 8 characters.
        ccfg: ccfg {
            compatible = "zmk,behavior-custom-config";
            #binding-cells = <1>;
            display-name = "Custom Config";
        };
        bsl: bsl {
            compatible = "zmk,behavior-base-layer-save";
            #binding-cells = <1>;
            display-name = "Base Layer Save";
        };
    };
};
