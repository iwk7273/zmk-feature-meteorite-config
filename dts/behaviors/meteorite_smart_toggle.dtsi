/*
 * Copyright (c) 2026 The ZMK Contributors
 *
 * SPDX-License-Identifier: MIT
 */

/ {
    behaviors {
        mst: mst {
            compatible = "zmk,behavior-meteorite-smart-toggle";
            #binding-cells = <0>;
            display-name = "meteorite smart toggle";
        };
    };
};
