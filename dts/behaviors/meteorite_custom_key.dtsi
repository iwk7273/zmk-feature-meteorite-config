/*
 * Copyright (c) 2026 The ZMK Contributors
 *
 * SPDX-License-Identifier: MIT
 */

/ {
    behaviors {
        mck: mck {
            compatible = "zmk,behavior-meteorite-custom-key";
            #binding-cells = <1>;
            display-name = "meteorite OS-Switch Mod (single)";
        };
    };
};
