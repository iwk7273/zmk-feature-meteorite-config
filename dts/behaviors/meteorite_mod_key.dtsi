/*
 * Copyright (c) 2026 The ZMK Contributors
 *
 * SPDX-License-Identifier: MIT
 */

/ {
    behaviors {
        mmk: mmk {
            compatible = "zmk,behavior-meteorite-mod-key";
            #binding-cells = <2>;
            display-name = "meteorite OS-Switch Mod+Key";
        };
    };
};
