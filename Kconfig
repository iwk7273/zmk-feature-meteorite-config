## Kconfig
```kconfig
# Custom feature toggle module.

menuconfig ZMK_CUSTOM_CONFIG
    bool "Enable custom config settings"
    default y

config ZMK_METEORITE_FIRMWARE_BUILD_VERSION
    string "Firmware build version reported over Studio RPC"
    depends on ZMK_CUSTOM_CONFIG
    help
      Set by the user config repo (release-please managed). Reported in
      ConfigState.firmware_build_version. Empty disables reporting.

DT_COMPAT_ZMK_BEHAVIOR_SMART_TOGGLE := zmk,behavior-smart-toggle
DT_COMPAT_ZMK_INPUT_PROCESSOR_METEORITE_MOTION_SCALER := zmk,input-processor-meteorite-motion-scaler
DT_COMPAT_ZMK_INPUT_PROCESSOR_METEORITE_SCROLL_TRANSFORM := zmk,input-processor-meteorite-scroll-transform
DT_COMPAT_ZMK_INPUT_PROCESSOR_METEORITE_XY_CLIPPER := zmk,input-processor-meteorite-xy-clipper
DT_COMPAT_ZMK_INPUT_PROCESSOR_METEORITE_SENSOR_ROTATION := zmk,input-processor-meteorite-sensor-rotation
DT_COMPAT_ZMK_INPUT_PROCESSOR_METEORITE_SCROLL_LAYER := zmk,input-processor-meteorite-scroll-layer
DT_COMPAT_ZMK_INPUT_PROCESSOR_METEORITE_BALL_PROFILE := zmk,input-processor-meteorite-ball-profile

config ZMK_BEHAVIOR_SMART_TOGGLE
    bool
    default $(dt_compat_enabled,$(DT_COMPAT_ZMK_BEHAVIOR_SMART_TOGGLE))

config ZMK_METEORITE_INPUT_PROCESSOR_MOTION_SCALER
    bool "Enable Meteorite motion scaler input processor"
    default $(dt_compat_enabled,$(DT_COMPAT_ZMK_INPUT_PROCESSOR_METEORITE_MOTION_SCALER))

config ZMK_METEORITE_INPUT_PROCESSOR_SCROLL_TRANSFORM
    bool "Enable Meteorite scroll transform input processor"
    default $(dt_compat_enabled,$(DT_COMPAT_ZMK_INPUT_PROCESSOR_METEORITE_SCROLL_TRANSFORM))

config ZMK_METEORITE_INPUT_PROCESSOR_XY_CLIPPER
    bool "Enable Meteorite XY clipper input processor"
    default $(dt_compat_enabled,$(DT_COMPAT_ZMK_INPUT_PROCESSOR_METEORITE_XY_CLIPPER))

config ZMK_METEORITE_INPUT_PROCESSOR_SENSOR_ROTATION
    bool "Enable Meteorite sensor rotation input processor"
    default $(dt_compat_enabled,$(DT_COMPAT_ZMK_INPUT_PROCESSOR_METEORITE_SENSOR_ROTATION))

config ZMK_METEORITE_INPUT_PROCESSOR_SCROLL_LAYER
    bool "Enable Meteorite scroll layer input processor"
    default $(dt_compat_enabled,$(DT_COMPAT_ZMK_INPUT_PROCESSOR_METEORITE_SCROLL_LAYER))

config ZMK_METEORITE_INPUT_PROCESSOR_BALL_PROFILE
    bool "Enable Meteorite ball profile router input processor"
    default $(dt_compat_enabled,$(DT_COMPAT_ZMK_INPUT_PROCESSOR_METEORITE_BALL_PROFILE))

DT_COMPAT_ZMK_BEHAVIOR_STUDIO_BT_DISC := zmk,behavior-studio-bt-disc
config ZMK_BEHAVIOR_STUDIO_BT_DISC
    bool
    default $(dt_compat_enabled,$(DT_COMPAT_ZMK_BEHAVIOR_STUDIO_BT_DISC))
    depends on ZMK_STUDIO_TRANSPORT_BLE
```

## dts/bindings/behaviors/zmk,behavior-base-layer-save.yaml
```yaml
# Copyright (c) 2025 The ZMK Contributors
# SPDX-License-Identifier: MIT

description: Base Layer Save Behavior

compatible: "zmk,behavior-base-layer-save"

include: one_param.yaml
```

## dts/bindings/behaviors/zmk,behavior-meteorite-bt-os.yaml
```yaml
# Copyright (c) 2026 The ZMK Contributors
# SPDX-License-Identifier: MIT

description: Meteorite Bluetooth + OS Behavior

compatible: "zmk,behavior-meteorite-bt-os"

include: two_param.yaml
```

## dts/bindings/behaviors/zmk,behavior-meteorite-custom-key.yaml
```yaml
# Copyright (c) 2026 The ZMK Contributors
# SPDX-License-Identifier: MIT

description: Meteorite Custom Key Behavior

compatible: "zmk,behavior-meteorite-custom-key"

include: one_param.yaml
```

## dts/bindings/behaviors/zmk,behavior-meteorite-encoder.yaml
```yaml
# Copyright (c) 2026 The ZMK Contributors
# SPDX-License-Identifier: MIT

description: Meteorite encoder keymap slot dispatcher

compatible: "zmk,behavior-meteorite-encoder"

include: behavior-metadata.yaml

properties:
  label:
    type: string
    required: false
    deprecated: true
  "#sensor-binding-cells":
    type: int
    required: true
    const: 0
  slots:
    type: array
    required: true
    description: >
      Keymap positions used for encoder actions. Entries are ordered as
      sensor 0 CW, sensor 0 CCW, sensor 1 CW, sensor 1 CCW.
  tap-ms:
    type: int
    default: 5

sensor-binding-cells: []
```

## dts/bindings/behaviors/zmk,behavior-meteorite-key-or-custom.yaml
```yaml
# Copyright (c) 2026 The ZMK Contributors
# SPDX-License-Identifier: MIT

description: Meteorite Key or Custom Behavior

compatible: "zmk,behavior-meteorite-key-or-custom"

include: one_param.yaml

properties:
  alt-cmd-tab:
    type: phandle
    required: false
    description: |
      Smart-toggle behavior used for the Alt/Cmd+Tab option.
```

## dts/bindings/behaviors/zmk,behavior-meteorite-mod-key.yaml
```yaml
# Copyright (c) 2026 The ZMK Contributors
# SPDX-License-Identifier: MIT

description: Meteorite Mod Key Behavior

compatible: "zmk,behavior-meteorite-mod-key"

include: two_param.yaml
```

## dts/bindings/behaviors/zmk,behavior-meteorite-mouse-scroll.yaml
```yaml
# Copyright (c) 2026 The Meteorite Contributors
# SPDX-License-Identifier: MIT

description: Metadata-enabled mouse scroll behavior wrapper for ZMK Studio

compatible: "zmk,behavior-meteorite-mouse-scroll"

include: one_param.yaml

properties:
  input-behavior:
    type: phandle
    required: true
    description: Existing zmk,behavior-input-two-axis device to receive scroll speed updates.
```

## dts/bindings/behaviors/zmk,behavior-meteorite-os-key.yaml
```yaml
# Copyright (c) 2026 The ZMK Contributors
# SPDX-License-Identifier: MIT

description: Meteorite OS Key Behavior

compatible: "zmk,behavior-meteorite-os-key"

include: two_param.yaml
```

## dts/bindings/behaviors/zmk,behavior-meteorite-os-macro.yaml
```yaml
# Copyright (c) 2026 The ZMK Contributors
# SPDX-License-Identifier: MIT

description: Meteorite OS Macro Behavior

compatible: "zmk,behavior-meteorite-os-macro"

include: two_param.yaml
```

## dts/bindings/behaviors/zmk,behavior-meteorite-smart-toggle.yaml
```yaml
# Copyright (c) 2026 The ZMK Contributors
# SPDX-License-Identifier: MIT

description: Meteorite Smart Toggle Selector Behavior

compatible: "zmk,behavior-meteorite-smart-toggle"

include: zero_param.yaml

properties:
  alt-cmd-tab:
    type: phandle
    required: false
    description: |
      Smart-toggle behavior used for the Alt/Cmd+Tab option.
```

## dts/bindings/behaviors/zmk,behavior-os-switch.yaml
```yaml
# Copyright (c) 2026 The ZMK Contributors
# SPDX-License-Identifier: MIT

description: OS Switch Behavior

compatible: "zmk,behavior-os-switch"

include: zero_param.yaml

properties:
  bindings:
    type: phandle-array
    required: true
```

## dts/bindings/behaviors/zmk,behavior-studio-bt-disc.yaml
```yaml
# Copyright (c) 2026 The ZMK Contributors
# SPDX-License-Identifier: MIT

description: Start temporary BLE advertising for Studio discovery

compatible: "zmk,behavior-studio-bt-disc"

include: zero_param.yaml
```

## dts/bindings/input/zmk,input-meteorite-sensor-rotation.yaml
```yaml
# SPDX-License-Identifier: MIT

description: Frame-aware input device that rotates relative sensor X/Y motion.

compatible: "zmk,input-meteorite-sensor-rotation"

include: base.yaml

properties:
  device:
    type: phandle
    required: true
    description: Raw input device whose relative X/Y frames are rotated.

  rotation-angle:
    type: int
    required: true
    description: Rotation angle in degrees, clamped to +/-70 and rounded to the nearest 5 degrees.
```

## dts/bindings/input_processors/zmk,input-processor-meteorite-ball-profile.yaml
```yaml
# Copyright (c) 2025 The ZMK Contributors
# SPDX-License-Identifier: MIT

description: |
  Ball profile router input processor. Resolves the effective ball profile from
  the highest active keymap layer and routes trackball motion accordingly:
  OFF passes through, SCROLL runs the wrapped scroll sub-chain, and the action
  profiles (BROWSER/DESKTOP/WINDOW/USER1) accumulate motion and fire one tap of
  the matching direction binding when the dominant axis crosses the threshold.

compatible: "zmk,input-processor-meteorite-ball-profile"

include: ip_zero_param.yaml

properties:
  input-processors:
    type: phandle-array
    required: true
    description: |
      SCROLL sub-chain, run in order when the active profile is SCROLL
      (typically xy_clipper -> scroll_motion_scaler -> to_wheel).
  bindings:
    type: phandle-array
    required: true
    description: |
      Fixed action-profile bindings, 12 entries in profile-major / direction
      order: BROWSER {LEFT,RIGHT,UP,DOWN}, DESKTOP {...}, WINDOW {...}.
      Use &ball_mosk <win> <mac> for OS-specific keys (param 0 = no-op for that
      OS) and &kp for OS-independent keys. USER1 is not listed here; it is built
      at runtime from the RPC-configured user bindings.
```

## dts/bindings/input_processors/zmk,input-processor-meteorite-motion-scaler.yaml
```yaml
# SPDX-License-Identifier: MIT

description: Meteorite input processor that scales relative pointer motion.

compatible: "zmk,input-processor-meteorite-motion-scaler"

include: ip_zero_param.yaml

properties:
  scaling-mode:
    type: int
    default: 0
    description: Fallback enable, 0 for disabled and non-zero for enabled.

  pointer-profile:
    type: int
    default: 0
    description: Fallback pointer profile, 0 Standard, 1 Stable, 2 Responsive, or 3 Custom.

  cpi:
    type: int
    default: 800
    description: Fallback sensor CPI used for physical-speed normalization.

  default-dt-ms:
    type: int
    default: 12
    description: Nominal report interval used for the first frame after a reset.
```

## dts/bindings/input_processors/zmk,input-processor-meteorite-scroll-transform.yaml
```yaml
# Copyright (c) 2026 The ZMK Contributors
# SPDX-License-Identifier: MIT

description: >
  Meteorite scroll response processor. It consumes raw X/Y motion, applies the
  selected Linear or Adaptive response before quantization, and emits horizontal
  or vertical wheel events while retaining sub-step motion internally.

compatible: "zmk,input-processor-meteorite-scroll-transform"

include: ip_zero_param.yaml

properties:
  threshold:
    type: int
    default: 20
    description: Fallback raw-count divisor used when custom config is disabled.

  invert-x:
    type: int
    default: 0
    description: Fallback horizontal inversion used when custom config is disabled.

  invert-y:
    type: int
    default: 0
    description: Fallback vertical inversion used when custom config is disabled.

  scaling-mode:
    type: int
    default: 0
    description: Fallback response mode, 0 for Linear and 1 for Adaptive.

  cpi:
    type: int
    default: 800
    description: Fallback sensor CPI used when custom config is disabled.

  default-dt-ms:
    type: int
    default: 12
    description: Nominal report interval used for the first frame after a reset.
```

## dts/bindings/input_processors/zmk,input-processor-meteorite-sensor-rotation.yaml
```yaml
# SPDX-License-Identifier: MIT

description: Meteorite input processor that rotates relative sensor X/Y motion.

compatible: "zmk,input-processor-meteorite-sensor-rotation"

include: ip_zero_param.yaml

properties:
  rotation-angle:
    type: int
    required: true
    description: Rotation angle in degrees.
```

## dts/bindings/input_processors/zmk,input-processor-meteorite-xy-clipper.yaml
```yaml
# SPDX-License-Identifier: MIT

description: Meteorite input processor that turns trackball X/Y motion into stepped scroll motion.

compatible: "zmk,input-processor-meteorite-xy-clipper"

include: ip_zero_param.yaml

properties:
  threshold:
    type: int
    required: false
    description: Accumulated input threshold required to emit one scroll step.
  invert-x:
    type: int
    required: false
    description: Invert X output.
  invert-y:
    type: int
    required: false
    description: Invert Y output.
```

## dts/bindings/input_processors/zmk,input-processor-scroll-layer.yaml
```yaml
# Copyright (c) 2025 The ZMK Contributors
# SPDX-License-Identifier: MIT

description: Input processor that maps X/Y to scroll when configured layers are active

compatible: "zmk,input-processor-scroll-layer"

include: ip_zero_param.yaml

properties:
  layer-1:
    type: int
    required: false
    description: First layer index to enable scrolling when CONFIG_ZMK_CUSTOM_CONFIG is disabled.
  layer-2:
    type: int
    required: false
    description: Second layer index to enable scrolling when CONFIG_ZMK_CUSTOM_CONFIG is disabled.
  input-processors:
    type: phandle-array
    required: true
```

## dts/bindings/zmk,ball-profile-defaults.yaml
```yaml
# Copyright (c) 2025 The ZMK Contributors
# SPDX-License-Identifier: MIT

description: Custom config ball profile defaults

compatible: "zmk,ball-profile-defaults"

properties:
  layer-profiles:
    type: array
    required: false
    description: |
      Default ball profile per keymap layer index. Each entry is an
      enum zmk_ball_profile value (0=OFF, 1=SCROLL, 2=BROWSER, 3=DESKTOP,
      4=WINDOW, 5=APP(reserved), 6=USER1). Entries beyond the layer count or
      array length default to OFF.
  sensitivity:
    type: int
    required: false
    description: |
      Default shared action-profile sensitivity (enum zmk_ball_sensitivity, in
      sensitivity order: 0=VERY_LIGHT, 1=LIGHT, 2=NORMAL, 3=HEAVY, 4=VERY_HEAVY;
      higher = less sensitive / larger flick). Defaults to NORMAL.
```

## dts/bindings/zmk,custom-config-defaults.yaml
```yaml
description: Custom config defaults

compatible: "zmk,custom-config-defaults"

properties:
  os-mode:
    type: int
  idle-timeout-s:
    type: int
  idle-sleep-timeout-s:
    type: int
```
